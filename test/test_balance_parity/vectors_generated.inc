// GENERATED by freecad-workspace gen_parity_vectors.py via export_cpp.py -- do not edit.
// Reference behaviour of the Python float64 core on float32-exact inputs. NOT a claim that the
// controller balances (PID sign/stability untested, freecad-workspace#359). NOT MCU or hardware evidence.
// PidStep.reset: call reset() on the PID BEFORE applying this step. Gains are SIM-derived.
#include <cstdint>
constexpr uint32_t kVecSchema = 1, kVecContractVersion = 1, kVecGainsHash = 0x1e60b0fcu;
constexpr float kTolAbs = 6.00000021e-06f;
struct LqrCase { float pitch, gyro_y, dt, cmd, raw; bool fault; };
struct PidStep { float pitch, dt, cmd; bool reset; float raw; bool fault; };
constexpr LqrCase kLqrCases[] = {
  { -0.108599998f, 0.0f, 0.0199999996f, 0.0f, 0.0f, false },
  { 0.0f, 0.0f, 0.0199999996f, 1.0f, 2.58668137f, false },
  { -0.107600003f, 0.0f, 0.0199999996f, 0.023818301f, 0.023818301f, false },
  { -0.1096f, 0.0f, 0.0199999996f, -0.023818478f, -0.023818478f, false },
  { -0.108599998f, 0.00999999978f, 0.0199999996f, 0.0349402241f, 0.0349402241f, false },
  { -0.108599998f, -0.00999999978f, 0.0199999996f, -0.0349402241f, -0.0349402241f, false },
  { -0.108599998f, 0.100000001f, 0.0199999996f, 0.349402279f, 0.349402279f, false },
  { -0.108599998f, -0.100000001f, 0.0199999996f, -0.349402279f, -0.349402279f, false },
  { -0.0986000001f, 0.100000001f, 0.0199999996f, 0.587586522f, 0.587586522f, false },
  { -0.118600003f, -0.100000001f, 0.0199999996f, -0.587586701f, -0.587586701f, false },
  { -0.058600001f, 0.0f, 0.0160000008f, 1.0f, 1.19092143f, false },
  { -0.158600003f, 0.0f, 0.0160000008f, -1.0f, -1.19092155f, false },
  { -0.0670000017f, 0.0f, 0.0160000008f, 0.990846574f, 0.990846574f, false },
  { -0.0659999996f, 0.0f, 0.0160000008f, 1.0f, 1.01466513f, false },
  { -0.150199994f, 0.0f, 0.0320000015f, -0.990846574f, -0.990846574f, false },
  { -0.151199996f, 0.0f, 0.0320000015f, -1.0f, -1.01466513f, false },
  { 0.0913999975f, 0.5f, 0.0199999996f, 1.0f, 6.51069736f, false },
  { -0.2086f, -1.5f, 0.0199999996f, -1.0f, -7.62287712f, false },
  { -0.0986000001f, 0.100000001f, 0.0f, 0.587586522f, 0.587586522f, false },
  { -0.0986000001f, 0.100000001f, 0.0160000008f, 0.587586522f, 0.587586522f, false },
  { -0.0986000001f, 0.100000001f, 0.0320000015f, 0.587586522f, 0.587586522f, false },
  { -0.108599998f, 0.5f, 0.0199999996f, 1.0f, 1.7470113f, false },
  { -0.0986000001f, 0.100000001f, -0.00100000005f, 0.0f, 0.0f, true },
  { -0.058600001f, 0.100000001f, -1.0f, 0.0f, 0.0f, true },
};
constexpr PidStep kPidSeq[] = {
  { 0.0f, 0.0199999996f, 0.0f, true, 0.0f, false },
  { -0.00999999978f, 0.0160000008f, 0.041265998f, false, 0.041265998f, false },
  { -0.0199999996f, 0.0160000008f, 0.0512979962f, false, 0.0512979962f, false },
  { -0.0149999997f, 0.0160000008f, -0.000552999496f, false, -0.000552999496f, false },
  { 0.0f, 0.0320000015f, -0.0233654995f, false, -0.0233654995f, false },
  { 0.00999999978f, 0.0160000008f, -0.0411939994f, false, -0.0411939994f, false },
  { 0.0199999996f, 0.0160000008f, -0.0512259975f, false, -0.0512259975f, false },
  { 0.0149999997f, 0.0160000008f, 0.000624999462f, false, 0.000624999462f, false },
  { 0.00499999989f, 0.0320000015f, 0.0106089991f, false, 0.0106089991f, false },
  { -0.00499999989f, 0.0160000008f, 0.036241997f, false, 0.036241997f, false },
  { -0.0500000007f, 0.0f, 0.0500000007f, false, 0.0500000007f, false },
  { -0.0799999982f, 0.0f, 0.0799999982f, false, 0.0799999982f, false },
  { -0.0299999993f, 0.0160000008f, 0.108164996f, false, 0.108164996f, false },
  { -0.0199999996f, 0.0160000008f, -0.011177999f, false, -0.011177999f, false },
  { -0.0199999996f, -0.00999999978f, 0.0f, false, 0.0f, true },
  { -0.0199999996f, 0.0320000015f, 0.0201359987f, false, 0.0201359987f, false },
  { -0.00999999978f, 0.0160000008f, -0.0210979991f, false, -0.0210979991f, false },
  { -1.0f, 0.0160000008f, 1.0f, false, 4.0955019f, false },
  { -2.0f, 0.0160000008f, 1.0f, false, 5.12995195f, false },
  { -3.0f, 0.0320000015f, 1.0f, false, 4.57705212f, false },
  { -3.0f, 0.0160000008f, 1.0f, false, 3.01935196f, false },
  { -3.0f, 0.0160000008f, 1.0f, false, 3.02415204f, false },
  { -3.0f, 0.0160000008f, 1.0f, false, 3.02895188f, false },
  { -3.0f, 0.0320000015f, 1.0f, false, 3.03855205f, false },
  { -3.0f, 0.0160000008f, 1.0f, false, 3.04335189f, false },
  { -3.0f, 0.0160000008f, 1.0f, false, 3.04815197f, false },
  { -3.0f, 0.0160000008f, 1.0f, false, 3.05295205f, false },
  { -3.0f, 0.0320000015f, 1.0f, false, 3.06255198f, false },
  { -3.0f, 0.0160000008f, 1.0f, false, 3.06735206f, false },
  { -3.0f, 0.0160000008f, 1.0f, false, 3.0721519f, false },
  { -3.0f, 0.0160000008f, 1.0f, false, 3.07695198f, false },
  { -3.0f, 0.0320000015f, 1.0f, false, 3.0865519f, false },
  { -3.0f, 0.0160000008f, 1.0f, false, 3.09135199f, false },
  { -3.0f, 0.0160000008f, 1.0f, false, 3.09615207f, false },
  { -3.0f, 0.0160000008f, 1.0f, false, 3.0999999f, false },
  { -3.0f, 0.0320000015f, 1.0f, false, 3.0999999f, false },
  { -3.0f, 0.0160000008f, 1.0f, false, 3.0999999f, false },
  { -3.0f, 0.0160000008f, 1.0f, false, 3.0999999f, false },
  { -3.0f, 0.0160000008f, 1.0f, false, 3.0999999f, false },
  { -3.0f, 0.0320000015f, 1.0f, false, 3.0999999f, false },
  { -3.0f, 0.0160000008f, 1.0f, false, 3.0999999f, false },
  { -3.0f, 0.0160000008f, 1.0f, false, 3.0999999f, false },
  { -2.0f, 0.0160000008f, -1.0f, false, -1.02499986f, false },
  { -1.0f, 0.0320000015f, -0.462499946f, false, -0.462499946f, false },
  { 0.0f, 0.0160000008f, -1.0f, false, -3.02499986f, false },
  { 0.0f, 0.0199999996f, 0.0f, true, 0.0f, false },
  { 1.0f, 0.0160000008f, -1.0f, false, -4.12659979f, false },
  { 2.0f, 0.0320000015f, -1.0f, false, -3.5704999f, false },
  { 3.0f, 0.0160000008f, -1.0f, false, -6.13779974f, false },
  { 3.0f, 0.0320000015f, -1.0f, false, -3.0223999f, false },
  { 3.0f, 0.0160000008f, -1.0f, false, -3.02719998f, false },
  { 3.0f, 0.0320000015f, -1.0f, false, -3.03679991f, false },
  { 3.0f, 0.0160000008f, -1.0f, false, -3.04159999f, false },
  { 3.0f, 0.0320000015f, -1.0f, false, -3.05119991f, false },
  { 3.0f, 0.0160000008f, -1.0f, false, -3.05599999f, false },
  { 3.0f, 0.0320000015f, -1.0f, false, -3.06559992f, false },
  { 3.0f, 0.0160000008f, -1.0f, false, -3.0704f, false },
  { 3.0f, 0.0320000015f, -1.0f, false, -3.07999992f, false },
  { 3.0f, 0.0160000008f, -1.0f, false, -3.0848f, false },
  { 3.0f, 0.0320000015f, -1.0f, false, -3.09439993f, false },
  { 3.0f, 0.0160000008f, -1.0f, false, -3.09920001f, false },
  { 3.0f, 0.0320000015f, -1.0f, false, -3.0999999f, false },
  { 3.0f, 0.0160000008f, -1.0f, false, -3.0999999f, false },
  { 3.0f, 0.0320000015f, -1.0f, false, -3.0999999f, false },
  { 3.0f, 0.0160000008f, -1.0f, false, -3.0999999f, false },
  { 3.0f, 0.0320000015f, -1.0f, false, -3.0999999f, false },
  { 3.0f, 0.0160000008f, -1.0f, false, -3.0999999f, false },
  { 3.0f, 0.0320000015f, -1.0f, false, -3.0999999f, false },
  { 3.0f, 0.0160000008f, -1.0f, false, -3.0999999f, false },
  { 3.0f, 0.0320000015f, -1.0f, false, -3.0999999f, false },
  { 3.0f, 0.0160000008f, -1.0f, false, -3.0999999f, false },
  { 2.0f, 0.0320000015f, -0.537500024f, false, -0.537500024f, false },
  { 1.0f, 0.0160000008f, 1.0f, false, 2.02499986f, false },
  { 0.0f, 0.0320000015f, 1.0f, false, 1.46249998f, false },
};
